/**
 * @cliArgs --device "XWRL684X" --part "Default" --package "FCCSP" --context "r5fss0-0" --product "MMWAVE-L-SDK-6@06.01.00.01"
 * @versions {"tool":"1.26.0+4000"}
 */

/**
 * Health Detection Project - MSS SysConfig
 *
 * Reference: AWRL6844_InCabin_Demos/src/mss/xwrL684x-evm/r5fss0-0_freertos/example.syscfg
 * Simplified: Removed power management, INA monitors (not needed for basic health detection)
 *
 * Created: 2026-01-08
 */

/**
 * Import the modules used in this configuration.
 */
const flash      = scripting.addModule("/board/flash/flash", {}, false);
const flash1     = flash.addInstance();
const adcbuf     = scripting.addModule("/drivers/adcbuf/adcbuf", {}, false);
const adcbuf1    = adcbuf.addInstance();
const cbuff      = scripting.addModule("/drivers/cbuff/cbuff", {}, false);
const cbuff1     = cbuff.addInstance();
const edma       = scripting.addModule("/drivers/edma/edma", {}, false);
const edma1      = edma.addInstance();
const edma2      = edma.addInstance();
const edma3      = edma.addInstance();
const gpio       = scripting.addModule("/drivers/gpio/gpio", {}, false);
const gpio1      = gpio.addInstance();
const hwa        = scripting.addModule("/drivers/hwa/hwa", {}, false);
const hwa1       = hwa.addInstance();
const ipc        = scripting.addModule("/drivers/ipc/ipc");
const uart       = scripting.addModule("/drivers/uart/uart", {}, false);
const uart1      = uart.addInstance();
const uart2      = uart.addInstance();
const clock      = scripting.addModule("/kernel/dpl/clock");
const mpu_armv7  = scripting.addModule("/kernel/dpl/mpu_armv7", {}, false);
const mpu_armv71 = mpu_armv7.addInstance();
const mpu_armv72 = mpu_armv7.addInstance();

/**
 * Write custom configuration values to the imported modules.
 */

/* Flash configuration for firmware storage */
flash1.$name                  = "CONFIG_FLASH0";
flash1.peripheralDriver.$name = "CONFIG_QSPI0";

/* ADC buffer for radar data capture */
adcbuf1.$name = "CONFIG_ADCBUF0";

/* CBUFF for data streaming */
cbuff1.$name = "CONFIG_CBUFF0";

/* EDMA instance 1 - For DSS_A (UART, Flash, CBUFF) */
edma1.$name                        = "CONFIG_EDMA0";
edma1.instance                     = "EDMA_DSS_A";
edma1.edmaRmDmaCh[0].$name         = "CONFIG_EDMA_RM0";
edma1.edmaRmQdmaCh[0].$name        = "CONFIG_EDMA_RM1";
edma1.edmaRmTcc[0].$name           = "CONFIG_EDMA_RM2";
edma1.edmaRmParam[0].$name         = "CONFIG_EDMA_RM3";
edma1.edmaRmReservedDmaCh[0].$name = "CONFIG_EDMA_RM4";

/* EDMA instance 2 - For DSS_B */
edma2.$name                        = "CONFIG_EDMA1";
edma2.instance                     = "EDMA_DSS_B";
edma2.regionId                     = 1;
edma2.edmaRmDmaCh[0].$name         = "CONFIG_EDMA_RM5";
edma2.edmaRmQdmaCh[0].$name        = "CONFIG_EDMA_RM6";
edma2.edmaRmTcc[0].$name           = "CONFIG_EDMA_RM7";
edma2.edmaRmParam[0].$name         = "CONFIG_EDMA_RM8";
edma2.edmaRmReservedDmaCh[0].$name = "CONFIG_EDMA_RM9";

/* EDMA instance 3 - Additional DMA */
edma3.$name                        = "CONFIG_EDMA2";
edma3.edmaRmDmaCh[0].$name         = "CONFIG_EDMA_RM10";
edma3.edmaRmQdmaCh[0].$name        = "CONFIG_EDMA_RM11";
edma3.edmaRmTcc[0].$name           = "CONFIG_EDMA_RM12";
edma3.edmaRmParam[0].$name         = "CONFIG_EDMA_RM13";
edma3.edmaRmReservedDmaCh[0].$name = "CONFIG_EDMA_RM14";

/* GPIO for status LED */
gpio1.pinDir               = "OUTPUT";
gpio1.$name                = "GPIO_LED";
gpio1.GPIO.gpioPin.$assign = "PAD_AW";

/* HWA accelerator */
hwa1.$name = "CONFIG_HWA0";

/* UART0 - CLI interface (115200 baud, with EDMA) */
uart1.$name      = "CONFIG_UART0";
uart1.edmaConfig = edma1;

/* UART1 - Data output to mmWave Visualizer (high speed, no interrupt) */
uart2.$name      = "CONFIG_UART1";
uart2.intrEnable = "DISABLE";
uart2.baudRate   = 1250000;
uart2.edmaConfig = edma1;

/* Flash EDMA configuration */
flash1.peripheralDriver.edmaConfig = edma1;

/* CBUFF EDMA configuration */
cbuff1.edmaConfig = edma1;

/* DSP clock frequency */
clock.DSPClockFreq = "SOC_C66CoreFreq400MHz";

/* MPU Region 0 - Non-cached memory */
mpu_armv71.$name      = "CONFIG_MPU_REGION0";
mpu_armv71.attributes = "NonCached";

/* MPU Region 1 - Device memory for peripherals */
mpu_armv72.$name        = "CONFIG_MPU_REGION2";
mpu_armv72.size         = 28;
mpu_armv72.baseAddr     = 0x50000000;
mpu_armv72.allowExecute = false;
mpu_armv72.attributes   = "Device";

/**
 * Pinmux solution for unlocked pins/peripherals. This ensures that minor changes to the automatic solver in a future
 * version of the tool will not impact the pinmux you originally saw.  These lines can be completely deleted in order to
 * re-solve from scratch.
 */
flash1.peripheralDriver.QSPI.$suggestSolution       = "QSPI0";
flash1.peripheralDriver.QSPI.DOUT.$suggestSolution  = "PAD_AC";
flash1.peripheralDriver.QSPI.DIN.$suggestSolution   = "PAD_AD";
flash1.peripheralDriver.QSPI.QDIN0.$suggestSolution = "PAD_AE";
flash1.peripheralDriver.QSPI.QDIN1.$suggestSolution = "PAD_AF";
flash1.peripheralDriver.QSPI.CLK.$suggestSolution   = "PAD_AA";
flash1.peripheralDriver.QSPI.N.$suggestSolution     = "PAD_AB";
gpio1.GPIO.$suggestSolution                         = "GPIO";
uart1.UART.$suggestSolution                         = "UARTB";
uart1.UART.RX.$suggestSolution                      = "PAD_AP";
uart1.UART.TX.$suggestSolution                      = "PAD_AO";
uart2.UART.$suggestSolution                         = "UARTA";
uart2.UART.RX.$suggestSolution                      = "PAD_AM";
uart2.UART.TX.$suggestSolution                      = "PAD_AN";
